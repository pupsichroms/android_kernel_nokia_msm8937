// SPDX-License-Identifier: GPL-2.0-only
/dts-v1/;

#include "../vendor-legacy/qcom/msm8940.dtsi"
#include "ple-d1c-core.dtsi"

/ {
	model = "Qualcomm Technologies, Inc. MSM8940-PMI8950 - FIH D1C EVT1";
	compatible = "qcom,msm8940-mtp", "qcom,msm8940", "qcom,mtp";
	qcom,board-id = <0x91 0>;
	qcom,pmic-id = <0x10019 0x020011 0x0 0x0>;
};

// SPDX-License-Identifier: GPL-2.0-only
/dts-v1/;

#include "../vendor-legacy/qcom/msm8937.dtsi"
#include "ple-d1c-core.dtsi"

/ {
	model = "Qualcomm Technologies, Inc. MSM8937-PMI8950 - FIH D1C PVT";
	compatible = "qcom,msm8937-mtp", "qcom,msm8937", "qcom,mtp";
	qcom,board-id = <0x91 0>;
	qcom,msm-id = <294 0x3000>;
	qcom,pmic-id = <0x10019 0x010011 0x0 0x0>;
};

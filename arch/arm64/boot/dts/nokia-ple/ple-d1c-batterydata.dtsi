// SPDX-License-Identifier: GPL-2.0-only
/*
 * Exact Nokia 6 D1C battery profiles from HMD Android 9 source commit
 * d548dae4af7fa5a75be88ce2e93f95ad4c867777.
 */

/ {
	d1c_batterydata: qcom,battery-data {
		qcom,batt-id-range-pct = <30>;

		qcom,fih-d1c-4v4-3000mah-100k {
			qcom,nom-batt-capacity-mah = <3000>;
			qcom,max-voltage-uv = <4400000>;
			qcom,v-cutoff-uv = <3300000>;
			qcom,chg-term-ua = <100000>;
			qcom,batt-id-kohm = <100>;
			qcom,battery-type = "MSM8937_D1C_XF_100k_battery";
			qcom,cool-bat-decidegc = <150>;
			qcom,battery-beta = <3380>;
			qcom,chg-rslow-comp-c1 = <2783213>;
			qcom,chg-rslow-comp-c2 = <3372267>;
			qcom,chg-rs-to-rslow = <1906749>;
			qcom,chg-rslow-comp-thr = <0x99>;
			qcom,checksum = <0x28af>;
			qcom,gui-version = "PMI8950GUI - 2.0.0.16";
			qcom,fastchg-current-ma = <2100>;
			qcom,fastchg-current-comp = <1200>;
			qcom,high-float-voltage-comp = <16>;
			qcom,low-float-voltage-comp = <6>;
			qcom,high-fastchg-current-comp = <1200>;
			qcom,low-fastchg-current-comp = <700>;
			qcom,fg-cc-cv-threshold-mv = <4390>;
			qcom,thermal-coefficients = [c5 86 be 50 d1 37];
			qcom,fg-profile-data = [
				e0 83 d7 7c 27 81 6c 77
				65 83 a3 74 9a 89 96 94
				41 82 1d 99 f8 b7 36 c8
				56 11 20 83 a7 6a 97 6a
				f4 33 3f 83 54 78 61 84
				a2 7b 83 82 7c 93 5c b5
				2e c1 77 12 43 0c a8 58
				14 70 71 fd 68 3d d9 3d
				3f 29 00 00 b0 46 d1 41
				3f 31 00 00 00 00 00 00
				00 00 00 00 f0 73 f4 72
				c6 5d a5 82 e8 6f 26 62
				ad 6d 54 70 78 6d 07 59
				e7 75 07 a1 24 b8 63 04
				64 a0 71 0c 28 00 ff 36
				f0 11 30 03 00 00 00 0c
			];
		};

		qcom,fih-d1c-4v4-3000mah-200k {
			qcom,nom-batt-capacity-mah = <3000>;
			qcom,max-voltage-uv = <4400000>;
			qcom,v-cutoff-uv = <3300000>;
			qcom,chg-term-ua = <100000>;
			qcom,batt-id-kohm = <200>;
			qcom,battery-type = "MSM8937_D1C_SDI_200k_battery";
			qcom,cool-bat-decidegc = <150>;
			qcom,battery-beta = <3435>;
			qcom,chg-rslow-comp-c1 = <3005570>;
			qcom,chg-rslow-comp-c2 = <4535721>;
			qcom,chg-rs-to-rslow = <1263683>;
			qcom,chg-rslow-comp-thr = <0xab>;
			qcom,checksum = <0xee09>;
			qcom,gui-version = "PMI8950GUI - 2.0.0.16";
			qcom,fastchg-current-ma = <2100>;
			qcom,fastchg-current-comp = <1200>;
			qcom,high-float-voltage-comp = <16>;
			qcom,low-float-voltage-comp = <6>;
			qcom,high-fastchg-current-comp = <1200>;
			qcom,low-fastchg-current-comp = <700>;
			qcom,fg-cc-cv-threshold-mv = <4390>;
			qcom,thermal-coefficients = [c5 86 be 50 d1 37];
			qcom,fg-profile-data = [
				df 83 bb 7c 0a 81 2e 77
				62 83 48 6f 0e 89 3c 94
				30 82 32 9a 85 bd a9 ca
				56 0e f2 83 14 7d 45 81
				9c 77 58 83 12 68 25 80
				e5 8c 5a 82 95 99 f9 bc
				f5 c9 54 0d 62 0c 7b 58
				14 70 77 fe f2 3d 9f 44
				a6 3b 00 00 0a 46 50 33
				8d 36 00 00 00 00 00 00
				00 00 00 00 4c 72 11 71
				93 76 d2 83 aa 76 f6 6b
				1a 6e 4c 71 f4 6f f6 63
				8f 63 52 a8 20 7a 62 d4
				64 a0 71 0c 28 00 ff 36
				f0 11 30 03 00 00 00 0c
			];
		};
	};
};
